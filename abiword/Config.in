## abiword/Config.in
```kconfig
config BR2_PACKAGE_ABIWORD
	bool "abiword"
	select BR2_PACKAGE_LIBRSVG_OLD
	select BR2_PACKAGE_LIBGSF
	select BR2_PACKAGE_WV
	select BR2_PACKAGE_ENCHANT
	select BR2_PACKAGE_BOOST
	select BR2_PACKAGE_LIBXSLT
	select BR2_PACKAGE_LIBGTK2
	select BR2_PACKAGE_GOFFICE
	select BR2_PACKAGE_LIBGLADE
	help
		this word processor was once thought to be
		entirely fucking dead. 
		
		surprise! its not.
		
		some patches stolen from arch AUR abiword-gtk2
		BROKEN 3-24-2025:
		tried to do a downgrade to 2.6.x, did not working
		ultimately decided to can the concept of including an office
		suite in 1.0
```

## atril/Config.in
```kconfig
config BR2_PACKAGE_ATRIL
	bool "atril"
	depends on BR2_PACKAGE_LIBGTK2
	depends on BR2_PACKAGE_CAIRO
	select BR2_PACKAGE_GCONF
	select BR2_PACKAGE_GSETTINGS_DESKTOP_SCHEMAS
	select BR2_PACKAGE_POPPLER
	select BR2_PACKAGE_MATE_DESKTOP
	help
		Atril is a document viewer, good for viewing documents
		such as PDF files, among other things.
		
		from the MATE Desktop
		https://mate-desktop.org/
```

## devicegcc/Config.in
```kconfig
config BR2_PACKAGE_DEVICEGCC
	bool "devicegcc"
	depends on BR2_PACKAGE_MPFR
	depends on BR2_PACKAGE_MPC
	depends on BR2_PACKAGE_GMP
	help
		GCC is a compiler that compiles your shitcode to compiled
		shitcode. it  really does not like your shitcode but
		it tolerates it anyway
		
		https://ftp.gnu.org/gnu/gcc
```

## dosemu/Config.in
```kconfig
config BR2_PACKAGE_DOSEMU
	bool "dosemu"
	select BR2_PACKAGE_GPM
	select BR2_PACKAGE_FLUIDSYNTH
	depends on BR2_PACKAGE_ALSA_LIB
	help
		DOSEMU is a way to run dos applications on linux
		does not work at all like how DOSbox works.
		
		thanks to gentoo for still packaging this oldass software
		BROKEN 3-24-2025:
		appears to compile fine, but does not accept keyboard input
		once a DOS actually starts.
```

## dosemu2/Config.in
```kconfig
config BR2_PACKAGE_DOSEMU2
	bool "dosemu2"
	select BR2_PACKAGE_GPM
	select BR2_PACKAGE_FLUIDSYNTH
	depends on BR2_PACKAGE_ALSA_LIB
	help
		DOSEMU2 is apparently a fork/continuation of the original
		dosemu project.
		
		I have no fucking idea if this shit actually works though.
```

## file_roller/Config.in
```kconfig
config BR2_PACKAGE_FILE_ROLLER
	bool "file_roller"
	depends on BR2_PACKAGE_LIBGTK2
	select BR2_PACKAGE_GCONF
	select BR2_PACKAGE_GSETTINGS_DESKTOP_SCHEMAS
	help
		GNOME file archival utility. old version that still
		uses gtk2, tho with optional gtk3 support thrown in
		for some reason.
		
		may or may not actually be the one from MATE
```

## foxtoolkit/Config.in
```kconfig
config BR2_PACKAGE_FOXTOOLKIT
	bool "foxtoolkit"
	help
		fox toolkit is a ui framework that exists. I bet you didn't 
		know it existed!
		
		http://www.fox-toolkit.org/
```

## gimp/Config.in
```kconfig
config BR2_PACKAGE_GIMP
	bool "gimp"
	select BR2_PACKAGE_LIBGTK2
	select BR2_PACKAGE_LIBRSVG_OLD
	select BR2_PACKAGE_LIBART
	help
		very fucking old gimp. should perform ok
		on very old machines
		
		GIMP is an image editor
		https://www.gimp.org/
```

## gnumeric/Config.in
```kconfig
config BR2_PACKAGE_GNUMERIC
	bool "gnumeric"
	select BR2_PACKAGE_LIBGLADE
	select BR2_PACKAGE_LIBGTK2
	select BR2_PACKAGE_GOFFICE
	help
		a spreadsheet program from gnome. it exists
		I guess.

		https://download.gnome.org/sources/gnumeric/1.10/
		
		notice: may or may not break your entire buildsystem
		results are unpredictable and annoying
		
		i got it to build in a screen session, while also
		outputting logs to a file via
		"make 2>&1 | tee file.txt", so try that if in doubt
		
		BROKEN, SORT OF: doesnt appear to install in testing
		compiles, but binary is not copied to target
		investigation will be required at some point
		3-18-2025
```

## goffice/Config.in
```kconfig
config BR2_PACKAGE_GOFFICE
	bool "goffice"
	select BR2_PACKAGE_LIBGTK2
	select BR2_PACKAGE_PCRE
	depends on BR2_PACKAGE_LIBGSF
	help
		dependacy for gnumeric
```

## icewm/Config.in
```kconfig
config BR2_PACKAGE_ICEWM
	bool "icewm"
	depends on BR2_PACKAGE_IMLIB2
	depends on BR2_PACKAGE_XLIB_LIBXCOMPOSITE
	depends on BR2_PACKAGE_XLIB_LIBXDAMAGE
	depends on BR2_PACKAGE_XLIB_LIBXFIXES
	depends on BR2_PACKAGE_XLIB_LIBXFT
	depends on BR2_PACKAGE_XLIB_LIBXINERAMA
	depends on BR2_PACKAGE_XLIB_LIBXPM
	depends on BR2_PACKAGE_XLIB_LIBXRANDR
	depends on BR2_PACKAGE_XLIB_LIBXRENDER
	help
		icewm is a lightweight window manager that also provides
		stuff like a task bar.
		
		should be plenty fast on dinosaur computers
		https://github.com/ice-wm/icewm

comment "icewm depends on imlib2 and libxcomposite"
	depends on !BR2_PACKAGE_XLIB_LIBXCOMPOSITE
	depends on !BR2_PACKAGE_IMLIB2
```

## keybinder2/Config.in
```kconfig
config BR2_PACKAGE_KEYBINDER2
	bool "keybinder2"
	select BR2_PACKAGE_LIBGTK2
	help
		honestly i have no idea what the hell this is,
		but lxpanel needs it so
		
		based on how arch linux packages it
		https://archlinux.org/packages/extra/x86_64/libkeybinder2/
```

## libcrocoreinst/Config.in
```kconfig
config BR2_PACKAGE_LIBCROCOREINST
	bool "libcrocoreinst"
	help
		libcroco 0.6, readded to buildroot
		it was removed previously for unknown reasons
		
		https://download.gnome.org/sources/libcroco/0.6/
```

## libgsf/Config.in
```kconfig
config BR2_PACKAGE_LIBGSF
	bool "libgsf"
	select BR2_PACKAGE_LIBXML2
	help
		libgsf is a thing for handling structured file formats
		atleast whats what BLFS says. ive never heard of
		this fucking library before in my life
		
		https://download.gnome.org/sources/libgsf/1.14/
```

## libptytty/Config.in
```kconfig
config BR2_PACKAGE_LIBPTYTTY
	bool "libptytty"
	help
	pretty much a terminal library for rvxt
	who saw that coming
	
	BROKEN 3-17-2025:
	requires a CmakeFiles.txt patch that I am too lazy to make
```

## librsvg_old/Config.in
```kconfig
config BR2_PACKAGE_LIBRSVG_OLD
	select BR2_PACKAGE_LIBCROCOREINST
	select BR2_PACKAGE_GOBJECT_INTROSPECTION
	select BR2_PACKAGE_PANGO
	select BR2_PACKAGE_GDK_PIXBUF
	bool "librsvg_old"
	help
		the last c version of librsvg
		
		why did they port it to rust how dare they be racist to the
		intel i486 platform. smh
		
		https://download.gnome.org/sources/librsvg/2.40/
```

## libwnck/Config.in
```kconfig
config BR2_PACKAGE_LIBWNCK
	bool "libwnck"
	select BR2_PACKAGE_LIBGTK2
	select BR2_PACKAGE_POLKIT
	select BR2_PACKAGE_HARFBUZZ
	select BR2_PACKAGE_XLIB_LIBX11
	select BR2_PACKAGE_PANGO
	select BR2_PACKAGE_CAIRO
	help
		"Window Navigator Construction Kit" from gnome
		dependacy for lxpanel
		
		based on how arch linux packages it
		https://archlinux.org/packages/extra/x86_64/libwnck/
```

## libxmp/Config.in
```kconfig
config BR2_PACKAGE_LIBXMP
	bool "libxmp"
	help
		Libxmp is a library that allows playing back module files as
		pcm or something like that
		
		https://github.com/libxmp/libxmp
```

## lxde-common/Config.in
```kconfig
config BR2_PACKAGE_LXDE_COMMON
	bool "lxde-common"
	help
		common bits for the LXDE desktop
		based on arch's packaging of it
		
		https://archlinux.org/packages/extra/any/lxde-common/
```

## lxpanel/Config.in
```kconfig
config BR2_PACKAGE_LXPANEL
	bool "lxpanel"
	select BR2_PACKAGE_LIBWNCK
	select BR2_PACKAGE_KEYBINDER2
	depends on BR2_PACKAGE_ALSA_LIB
	help
		the taskbar thing for lxde. without this it would be
		pretty useless lmao
		
		based on how arch packages it
		https://archlinux.org/packages/extra/x86_64/lxpanel/

comment "lxpanel requires alsa-lib"
	depends on !BR2_PACKAGE_ALSA_LIB
```

## lxsession/Config.in
```kconfig
config BR2_PACKAGE_LXSESSION
	bool "lxsession"
	depends on BR2_PACKAGE_LIBGTK2
	select BR2_PACKAGE_POLKIT
	select BR2_PACKAGE_OPENBOX
	help
		the main lxde program bit thing. starts an LXDE session
		
		note: while you can use it with icewm, you probably shouldn't
		thus, this package also selects openbox
		you should probably also take lxpanel, too
		
		based on how arch packages it
		https://archlinux.org/packages/extra/x86_64/lxsession/

comment "lxsession depends on gtk2!"
	depends on !BR2_PACKAGE_LIBGTK2
```

## lxterm/Config.in
```kconfig
config BR2_PACKAGE_LXTERM
	bool "lxterminal"
	select BR2_PACKAGE_VTE_LEG
	help
		lxde terminal, but compiled using GTK2 instead of GTK3
		
		https://aur.archlinux.org/packages/lxterminal-gtk2
```

## mate_desktop/Config.in
```kconfig
config BR2_PACKAGE_MATE_DESKTOP
	bool "mate_desktop"
	depends on BR2_PACKAGE_LIBGTK2
	select BR2_PACKAGE_GCONF
	select BR2_PACKAGE_GSETTINGS_DESKTOP_SCHEMAS
	help
		Mate-Desktop is a bunch of crap that we need for some reason
		googling suggests its some kind of metapackage for loading
		.desktop files for some reason? I don't even know why we
		need this but Eye of Mate wants it so
		
		from the MATE Desktop
		https://mate-desktop.org/
```

## mateeye/Config.in
```kconfig
config BR2_PACKAGE_MATEEYE
	bool "mateeye"
	depends on BR2_PACKAGE_LIBGTK2
	select BR2_PACKAGE_GCONF
	select BR2_PACKAGE_GSETTINGS_DESKTOP_SCHEMAS
	select BR2_PACKAGE_SHARED_MIME_INFO
	select BR2_PACKAGE_MATE_DESKTOP
	help
		Eye of MATE is an image viewer for the MATE desktop
		of which it is a fork of eye of GNOME, from the GNOME 2 days
		
		I wouldve gone with the actual gnome 2 version, but based
		on my experiences with file-roller, it is easier to ship
		slightly older but still newer versions from MATE
		
		from the MATE Desktop
		https://mate-desktop.org/
```

## rxvt/Config.in
```kconfig
config BR2_PACKAGE_RXVT
	bool "rxvt"
	select BR2_PACKAGE_LIBPTYTTY
	help
	its a terminal. probably better then xterm
```
