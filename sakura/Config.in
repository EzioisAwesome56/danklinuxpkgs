## sakura/Config.in
```kconfig
config BR2_PACKAGE_SAKURA
	bool "sakura"
	select BR2_PACKAGE_LIBGTK2
	select BR2_PACKAGE_VTE_LEG
	help
		Sakura is a small and simple terminal emulator based on
		the gtk framework and it small
		
		we ship an older version because we do not provide gtk3
		https://github.com/dabisu/sakura
```

## vte_leg/Config.in
```kconfig
config BR2_PACKAGE_VTE_LEG
	bool "vte_leg"
	select BR2_PACKAGE_LIBGTK2
	select BR2_PACKAGE_GOBJECT_INTROSPECTION
	depends on BR2_PACKAGE_GETTEXT
	help
		legacy version of vte that doesnt need gtk3 or
		dumb transparency effects
		
		https://download.gnome.org/sources/vte/0.28/
```

## wv/Config.in
```kconfig
config BR2_PACKAGE_WV
	bool "wv"
	depends on BR2_PACKAGE_LIBGSF
	help
		wv is a library made by abiword for like
		reading microsoft word files or something
		atleast that is what BLFS tells me. they also
		provide the mirror for this source code!
		
		https://www.linuxfromscratch.org/blfs/view/svn/general/wv.html
```

## xfe/Config.in
```kconfig
config BR2_PACKAGE_XFE
	bool "xfefiles"
	depends on BR2_PACKAGE_FOXTOOLKIT
	help
		xfe is a small file manager based on the
		fox toolkit. it exists and works or something
		like that
		
		http://roland65.free.fr/xfe/index.php?page=home
		BROKEN 3-17-2025:
		claims to be unable to find part of fox toolkit despite
		it being installed

comment "xfe requires fox toolkit"
	depends on !BR2_PACKAGE_FOXTOOLKIT
```

## xmpcli/Config.in
```kconfig
config BR2_PACKAGE_XMPCLI
	bool "xmpcli"
	depends on BR2_PACKAGE_LIBXMP
	help
		XMPCLI is the cli frontend to libxmp from the devs
		of said library
		
		https://github.com/libxmp/libxmp
```
